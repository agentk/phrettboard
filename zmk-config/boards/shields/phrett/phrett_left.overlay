// phrett_left.overlay

#include "phrett.dtsi" // Notice that the main dtsi files are included in the overlay.

&kscan0 {
    col-gpios
        = <&gpio0 24 GPIO_ACTIVE_HIGH> // Col 0 in the schematic
        , <&gpio1  0 GPIO_ACTIVE_HIGH> // Col 1 in the schematic
        , <&gpio0 11 GPIO_ACTIVE_HIGH> // Col 2 in the schematic
        , <&gpio1  4 GPIO_ACTIVE_HIGH> // Col 3 in the schematic
        , <&gpio1  6 GPIO_ACTIVE_HIGH> // Col 4 in the schematic
        ;
};
