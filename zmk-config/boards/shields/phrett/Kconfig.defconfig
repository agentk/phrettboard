## zmk-config/boards/shields/phrett/Kconfig.defconfig
```kconfig
if SHIELD_PHRETT_LEFT

    config ZMK_KEYBOARD_NAME
        default "Phrettboard"

    config ZMK_SPLIT_BLE_ROLE_CENTRAL
        default y
endif

if SHIELD_PHRETT_LEFT || SHIELD_PHRETT_RIGHT
    config ZMK_SPLIT
        default y
endif
```

## zmk-config/boards/shields/phrett/Kconfig.shield
```kconfig
config SHIELD_PHRETT_LEFT
    def_bool $(shields_list_contains,phrett_left)

config SHIELD_PHRETT_RIGHT
    def_bool $(shields_list_contains,phrett_right)
```
